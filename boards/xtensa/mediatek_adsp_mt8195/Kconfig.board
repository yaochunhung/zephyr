## boards/xtensa/mediatek_adsp_mt8195/Kconfig.board
```kconfig
# Xtensa board configuration

# Copyright (c) 2022 MediaTek
# SPDX-License-Identifier: Apache-2.0

config  BOARD_MTK_ADSP_MT8195
	bool "MediaTek ADSP mt8195"
```

## boards/xtensa/mediatek_adsp_mt8195/Kconfig.defconfig
```kconfig
# Copyright (c) 2022 MediaTek
#
# SPDX-License-Identifier: Apache-2.0

if BOARD_MTK_ADSP_MT8195

config BOARD
	default "mediatek_adsp_mt8195"

config DUMMY_DMA
	bool
	default y
	depends on DMA

endif # BOARD_MTK_ADSP_MT8195
```

## soc/xtensa/mediatek_adsp/Kconfig
```kconfig
# MediaTek SoC family configuration options
#
# Copyright (c) 2022 MediaTek
# SPDX-License-Identifier: Apache-2.0

config SOC_FAMILY_MEDIATEK_ADSP
	bool
	select ARCH_HAS_COHERENCE

if SOC_FAMILY_MEDIATEK_ADSP

config SOC_FAMILY
	string
	default "mediatek_adsp"

# Select SoC Part No. and configuration options
source "soc/xtensa/mediatek_adsp/*/Kconfig.soc"

endif # SOC_FAMILY_MEDIATEK_ADSP
```

## soc/xtensa/mediatek_adsp/Kconfig.defconfig
```kconfig
# MediaTek SoC family default configuration options
#
# Copyright (c) 2022 MediaTek
# SPDX-License-Identifier: Apache-2.0

source "soc/xtensa/mediatek_adsp/*/Kconfig.defconfig.series"
```

## soc/xtensa/mediatek_adsp/Kconfig.soc
```kconfig
# MediaTek SoC series selection
#
# Copyright (c) 2022 MediaTek
# SPDX-License-Identifier: Apache-2.0

source "soc/xtensa/mediatek_adsp/*/Kconfig.series"
```

## soc/xtensa/mediatek_adsp/mt8195/Kconfig.defconfig.series
```kconfig
# Copyright (c) 2022 MediaTek
# SPDX-License-Identifier: Apache-2.0

if SOC_SERIES_MEDIATEK_MT8195

config SOC_SERIES
	string
	default "mt8195"

config SOC_TOOLCHAIN_NAME
	string
	default "mediatek_mt8195_adsp"

config SOC
	string
	default "mt8195"

config SMP
	default n

config XTENSA_TIMER
	default n

config SYS_CLOCK_HW_CYCLES_PER_SEC
	default 720000000 if XTENSA_TIMER

config SYS_CLOCK_TICKS_PER_SEC
	default 50000

config KERNEL_ENTRY
	default "__start"

config MULTI_LEVEL_INTERRUPTS
	default n

config 2ND_LEVEL_INTERRUPTS
	default n

config DYNAMIC_INTERRUPTS
	default y

config LOG
	default y

# To prevent test uses TEST_LOGGING_MINIMAL
config TEST_LOGGING_DEFAULTS
	default n
	depends on TEST

endif # SOC_SERIES_MEDIATEK_MT8195
```

## soc/xtensa/mediatek_adsp/mt8195/Kconfig.series
```kconfig
# Copyright (c) 2022 MediaTek
# SPDX-License-Identifier: Apache-2.0

config SOC_SERIES_MEDIATEK_MT8195
	bool "Mediatek MT8195"
	select SOC_FAMILY_MEDIATEK_ADSP
	select XTENSA
	select XTENSA_HAL if "$(ZEPHYR_TOOLCHAIN_VARIANT)" != "xcc"
	select XTENSA_RESET_VECTOR
	select XTENSA_USE_CORE_CRT1
	select ATOMIC_OPERATIONS_BUILTIN
	help
	  MediaTek MT8195
```

## soc/xtensa/mediatek_adsp/mt8195/Kconfig.soc
```kconfig
# Copyright (c) 2022 MediaTek
# SPDX-License-Identifier: Apache-2.0

choice
	prompt "MediaTek MT8195 SoC Selection"

	config SOC_MT8195
		bool "MT8195 SoC"
		depends on SOC_SERIES_MEDIATEK_MT8195

endchoice
```
